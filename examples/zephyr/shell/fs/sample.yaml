## examples/zephyr/shell/fs/sample.yaml
```yaml
sample:
  description: FS shell sample
  name: FS shell
tests:
  sample.filesystem.shell:
    platform_whitelist: nrf52840_m2
```

## west.yml
```yaml
# The west manifest file for nRF52840 M.2 DevKit.
#
# The per-installation west configuration file specifies the location of this
# manifest file. The "path" option in the [manifest] section of .west/config
# defines the folder that contains west.yml. The path is relative to the folder
# that contains .west.
#
# You can create your own manifest files and put them in any
# repository you want, to create your own custom installation.
# For example, you could create a manifest file in your own
# out-of-tree application directory, which would pull the nRF52840 M.2 DevKit repository
# in as an ordinary project.
#
# You can pass your manifest repositories to west init when creating a
# new installation. See the west documentation for more
# information.

manifest:
  defaults:
    remote: makerdiary

  remotes:
    - name: makerdiary
      url-base: https://github.com/makerdiary
    - name: zephyrproject
      url-base: https://github.com/zephyrproject-rtos

  # The list of external projects.
  #
  projects:
    - name: zephyr
      repo-path: zephyr
      west-commands: scripts/west-commands.yml
      remote: zephyrproject
      revision: e77985a2f0531a8fbefdb9ae2e5ea7c5e3dbd70f
    - name: cmsis
      revision: 542b2296e6d515b265e25c6b7208e8fea3014f90
      path: modules/hal/cmsis
      remote: zephyrproject
    - name: hal_nordic
      revision: 742d8fb839406951ef7f95d0132bfa8c2635343f
      path: modules/hal/nordic
      remote: zephyrproject   
    - name: lvgl
      revision: 74fc2e753a997bd71cefa34dd9c56dcb954b42e2
      path: modules/lib/gui/lvgl
      remote: zephyrproject
    - name: fatfs
      revision: 9ee6b9b9511151d0d64a74d532d39c6f2bbd4f16
      path: modules/fs/fatfs
      remote: zephyrproject
    - name: littlefs
      path: modules/fs/littlefs
      revision: 0aefdda69d236cb01f932117c1f32e9da09c0ec3
      remote: zephyrproject
    - name: tinycrypt
      path: modules/crypto/tinycrypt
      revision: 3e9a49d2672ec01435ffbf0d788db6d95ef28de0
      remote: zephyrproject

  self:
    path: nrf52840-m2-devkit
```
